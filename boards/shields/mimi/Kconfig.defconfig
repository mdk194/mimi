## boards/shields/mimi/Kconfig.defconfig
```kconfig
if SHIELD_MIMI_LEFT

config ZMK_KEYBOARD_NAME
    default "mimi"

config ZMK_SPLIT_ROLE_CENTRAL
    default y

endif

if SHIELD_MIMI_LEFT || SHIELD_MIMI_RIGHT

config ZMK_SPLIT
    default y

endif
```

## boards/shields/mimi/Kconfig.shield
```kconfig
config SHIELD_MIMI_DONGLE
    def_bool $(shields_list_contains,mimi_dongle)

config SHIELD_MIMI_LEFT
    def_bool $(shields_list_contains,mimi_left)

config SHIELD_MIMI_RIGHT
    def_bool $(shields_list_contains,mimi_right)
```
